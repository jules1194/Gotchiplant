//librerias
#include <dht.h>
#include <Adafruit_SSD1306.h>
#include <Wire.h>

//dht
#define DHTPIN 5
#define DHTTYPE DHT11
DHT dht(DHTPIN, DHTTYPE);
//gnd - gnd; vcc - 5v; DAT - D5;

//display
#define SCREEN_WIDTH 128
#define SCREEN_HEIGHT 64
Adafruit_SSD1306 display(SCREEN_WIDTH, SCREEN_HEIGHT, &Wire, -1);
//gnd - gnd; vcc - 3,3v; SCK - A5; SDA - A4;

// LDR
const int LEDPin = 13;
const int LDRPin = 4;
//gnd - gnd; vcc - 5v; DAT - D4;

// Higrometro
const int humedad = A0;
//gnd - gnd; vcc - 5v; DAT - A0;

// Vibracion
int Sensor = A1;
//gnd - gnd; vcc - 3,3v; DAT - A1;

//variables
int counter;

//imagenes

//happy
const unsigned char myBitmap1[] PROGMEM = {
  0x00, 0x00, 0x00, 0x00, 0x00, 0x00, 0x00, 0x00, 0x00, 0x00, 0x00, 0x00, 0x00, 0x00, 0x00, 0x00,
  0x00, 0x00, 0x00, 0x00, 0x00, 0x00, 0x00, 0x00, 0x00, 0x00, 0x00, 0x00, 0x00, 0x00, 0x00, 0x00,
  0x00, 0x00, 0x00, 0x00, 0x00, 0x00, 0x00, 0x00, 0x00, 0x00, 0x00, 0x00, 0x00, 0x00, 0x00, 0x00,
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  0x00, 0x00, 0x00, 0x00, 0x00, 0x00
};

//sad
const unsigned char myBitmap2[] PROGMEM = {
  0x00, 0x00, 0x00, 0x00, 0x00, 0x00, 0x00, 0x00, 0x00, 0x00, 0x00, 0x00, 0x00, 0x00, 0x00, 0x00,
  0x00, 0x00, 0x00, 0x00, 0x00, 0x00, 0x00, 0x00, 0x00, 0x00, 0x00, 0x00, 0x00, 0x00, 0x00, 0x00,
  0x00, 0x00, 0x00, 0x00, 0x00, 0x00, 0x00, 0x00, 0x00, 0x00, 0x00, 0x00, 0x00, 0x00, 0x00, 0x00,
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  0x00, 0x00, 0x00, 0x00, 0x00, 0x00
};

// 'walk1', 70x70px
const unsigned char epd_bitmap_walk1[] PROGMEM = {
  0x00, 0x00, 0x00, 0x00, 0x00, 0x00, 0x00, 0x00, 0x00, 0x00, 0x00, 0x00, 0x00, 0x00, 0x00, 0x00,
  0x00, 0x00, 0x00, 0x00, 0x00, 0x00, 0x00, 0x00, 0x00, 0x00, 0x00, 0x00, 0x00, 0x00, 0x00, 0x00,
  0x00, 0x00, 0x00, 0x00, 0x00, 0x00, 0x00, 0x00, 0x00, 0x00, 0x00, 0x00, 0x00, 0x00, 0x00, 0x00,
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  0x00, 0x00, 0x00, 0x00, 0x00, 0x00
};

// 'walk2', 70x70px
const unsigned char epd_bitmap_walk2[] PROGMEM = {
  0x00, 0x00, 0x00, 0x00, 0x00, 0x00, 0x00, 0x00, 0x00, 0x00, 0x00, 0x00, 0x00, 0x00, 0x00, 0x00,
  0x00, 0x00, 0x00, 0x00, 0x00, 0x00, 0x00, 0x00, 0x00, 0x00, 0x00, 0x00, 0x00, 0x00, 0x00, 0x00,
  0x00, 0x00, 0x00, 0x00, 0x00, 0x00, 0x00, 0x00, 0x00, 0x00, 0x00, 0x00, 0x00, 0x00, 0x00, 0x00,
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  0x00, 0x00, 0x00, 0x00, 0x00, 0x00
};



void setup() {
  Serial.begin(9600);
  Serial.println("");
  Serial.println("inicio");

  //variables
  counter = 0;

  //display
  display.begin(SSD1306_SWITCHCAPVCC, 0x3C);
  display.display();
  delay(2000);
  display.clearDisplay();
  randomSeed(analogRead(0));

  //dht
  dht.begin();

  // Configurar LDR
  pinMode(LEDPin, OUTPUT);
  pinMode(LDRPin, INPUT);
}

void loop() {
  if (counter < 3) {
    counter = counter + 1;
  } else {
    counter = 0;
  }

  Serial.print("Seleccion: ");
  Serial.println(counter);

  switch (counter) {
    case 0:
      readTemperature();
      break;
    case 1:
      readHumidity();
      break;
    case 2:
      readHigro();
      break;
    case 3:
      readLight();
      break;
    default:
      break;
  }
}

void readTemperature() {
  delay(5000);

  float t = dht.readTemperature();

  if (isnan(t)) {
    Serial.println("Error obteniendo los datos del sensor DHT11");
    return;
  }

  Serial.print("Temperatura: ");
  Serial.println(t);

  display.clearDisplay();
  display.setTextSize(1);
  display.setTextColor(WHITE);
  display.setCursor(0, 0);
  display.print("Temperatura ambiente: ");
  display.print(t);
  display.print("%");
  display.display();
  delay(1000);
  if (t < 23) {
    display.clearDisplay();
    display.setTextSize(1.5);
    display.setTextColor(WHITE);
    display.setCursor(40, 0);
    display.println("baja temp");
    Serial.println("baja temperatura");
    display.drawBitmap(30, 0, myBitmap2, 70, 70, WHITE);
    display.display();
    delay(200);
  }

  if (t > 37) {
    display.clearDisplay();
    display.setTextSize(1.5);
    display.setTextColor(WHITE);
    display.setCursor(40, 0);
    //display.println("mucha temp");
    //Serial.println("mucha temp");
    display.drawBitmap(30, 0, myBitmap2, 70, 70, WHITE);
    display.display();
    delay(2000);
  }

  if ((t > 23) && (t < 37)) {
    display.clearDisplay();
    display.setTextSize(1.5);
    display.setTextColor(WHITE);
    display.setCursor(40, 0);
    display.println("Buena temp");
    Serial.println("buena temperatura");
    display.drawBitmap(30, 0, myBitmap1, 70, 70, WHITE);
    display.display();
    delay(2000);
  }
}

void readHumidity() {
  delay(5000);

  float h = dht.readHumidity();

  if (isnan(h)) {
    Serial.println("Error obteniendo los datos del sensor DHT11");
    return;
  }

  Serial.print("Humedad: ");
  Serial.println(h);

  display.clearDisplay();
  display.setTextSize(1);
  display.setTextColor(WHITE);
  display.setCursor(0, 0);
  display.print("humedad ambiente: ");
  display.print(h);
  display.print("%");
  display.display();
  delay(1000);
  if (h < 600) {
    Serial.println("no hay humedad");
    display.clearDisplay();
    display.setTextSize(1.5);
    display.setTextColor(WHITE);
    display.setCursor(40, 0);
    display.println("poca humedad");
    display.drawBitmap(30, 0, myBitmap2, 70, 70, WHITE);
    display.display();
    delay(2000);
  }

  if (h > 900) {
    Serial.println("mucha humedad");
    display.clearDisplay();
    display.setTextSize(1.5);
    display.setTextColor(WHITE);
    display.setCursor(50, 0);
    display.println("mucha humedad");
    display.drawBitmap(40, 0, myBitmap2, 70, 70, WHITE);
    display.display();
    delay(2000);
  }

  if ((h > 600) && (h < 800)) {
    display.clearDisplay();
    display.setTextSize(1.5);
    display.setTextColor(WHITE);
    display.setCursor(40, 0);
    display.println("Buena humedad");
    display.drawBitmap(30, 0, myBitmap1, 70, 70, WHITE);
    display.display();
    delay(2000);
  }
}



void readHigro() {
  Serial.println("Leyendo humedad suelo Higrometro");
  int soilHumidity = analogRead(humedad);
  Serial.print("Humedad suelo: ");
  Serial.println(soilHumidity);
  display.clearDisplay();
  display.setTextSize(1);
  display.setTextColor(WHITE);
  display.setCursor(0, 0);
  display.print("Humedad suelo: ");
  display.print(soilHumidity);
  display.display();
  Serial.println("Terminó de leer humedad suelo");
  delay(1000);
  if (soilHumidity > 900) {
    Serial.println("no hay agua");
    display.clearDisplay();
    display.setTextSize(1.5);
    display.setTextColor(WHITE);
    display.setCursor(40, 0);
    display.println("poca agua");
    display.drawBitmap(30, 0, myBitmap2, 70, 70, WHITE);
    display.display();
    delay(2000);
  } else if ((soilHumidity > 600 && soilHumidity < 800)) {
    Serial.println("buena agua");
    display.clearDisplay();
    display.setTextSize(1.5);
    display.setTextColor(WHITE);
    display.setCursor(40, 0);
    display.println("bien");
    display.drawBitmap(30, 0, myBitmap1, 70, 70, WHITE);
    display.display();
    delay(2000);
  } else if (soilHumidity < 600) {
    Serial.println("mucha agua");
    display.clearDisplay();
    display.setTextSize(1.5);
    display.setTextColor(WHITE);
    display.setCursor(40, 0);
    display.println("mucha agua");
    display.drawBitmap(30, 0, myBitmap2, 70, 70, WHITE);
    display.display();
    delay(2000);
  }
  delay(5000);
}

void readLight() {
  Serial.println("Leyendo luz LDR");
  int lightValue = digitalRead(LDRPin);
  display.clearDisplay();
  display.setTextSize(1);
  display.setTextColor(WHITE);
  display.setCursor(0, 0);
  Serial.print("luz ambiental: ");
  Serial.println(lightValue);
  display.print("luz ambiental: ");
  display.print(lightValue);
  display.display();
  if (lightValue == HIGH) {
    Serial.println("Hay luz");
  } else {
    Serial.println("No hay luz");
  }
  Serial.println("Termino de leer luz");
  delay(5000);
}